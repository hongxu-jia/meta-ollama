## conf/distro/include/cuda-x86-64.inc
```bitbake
TEGRA_PKGARCH:x86-64 = "${TUNE_PKGARCH}"
SOC_FAMILY_PKGARCH:x86-64 = "${TUNE_PKGARCH}"
OVERRIDES:prepend = "cuda:"

COMPATIBLE_MACHINE:pn-cuda-compatibility-workarounds:class-target = "(genericx86-64|qemux86-64|intel-x86-64)"
COMPATIBLE_MACHINE:pn-cuda-target-environment:class-target = "(genericx86-64|qemux86-64|intel-x86-64)"
COMPATIBLE_MACHINE:pn-cuda-libraries:class-target = "(genericx86-64|qemux86-64|intel-x86-64)"
COMPATIBLE_MACHINE:pn-libcublas:class-target = "(genericx86-64|qemux86-64|intel-x86-64)"
COMPATIBLE_MACHINE:pn-libcurand:class-target = "(genericx86-64|qemux86-64|intel-x86-64)"
COMPATIBLE_MACHINE:pn-libcufile:class-target = "(genericx86-64|qemux86-64|intel-x86-64)"
COMPATIBLE_MACHINE:pn-cuda-nvcc-headers:class-target = "(genericx86-64|qemux86-64|intel-x86-64)"
COMPATIBLE_MACHINE:pn-libcusolver:class-target = "(genericx86-64|qemux86-64|intel-x86-64)"
COMPATIBLE_MACHINE:pn-libcusparse:class-target = "(genericx86-64|qemux86-64|intel-x86-64)"
COMPATIBLE_MACHINE:pn-libnpp:class-target = "(genericx86-64|qemux86-64|intel-x86-64)"
COMPATIBLE_MACHINE:pn-libnvjitlink:class-target = "(genericx86-64|qemux86-64|intel-x86-64)"
COMPATIBLE_MACHINE:pn-libnvfatbin:class-target = "(genericx86-64|qemux86-64|intel-x86-64)"
COMPATIBLE_MACHINE:pn-cuda-cudart:class-target = "(genericx86-64|qemux86-64|intel-x86-64)"
COMPATIBLE_MACHINE:pn-cuda-nvrtc:class-target = "(genericx86-64|qemux86-64|intel-x86-64)"
COMPATIBLE_MACHINE:pn-cuda-cccl:class-target = "(genericx86-64|qemux86-64|intel-x86-64)"
COMPATIBLE_MACHINE:pn-cuda-crt:class-target = "(genericx86-64|qemux86-64|intel-x86-64)"
COMPATIBLE_MACHINE:pn-cuda-nvml:class-target = "(genericx86-64|qemux86-64|intel-x86-64)"
COMPATIBLE_MACHINE:pn-libcufft:class-target = "(genericx86-64|qemux86-64|intel-x86-64)"
COMPATIBLE_MACHINE:pn-cuda-driver:class-target = "(genericx86-64|qemux86-64|intel-x86-64)"
```

## conf/layer.conf
```bitbake
# We have a conf and classes directory, add to BBPATH
BBPATH =. "${LAYERDIR}:"

# We have a packages directory, add to BBFILES
BBFILES += "${LAYERDIR}/recipes-*/*/*.bb \
            ${LAYERDIR}/recipes-*/*/*.bbappend"

BBFILE_COLLECTIONS += "meta-ollama"
BBFILE_PATTERN_meta-ollama = "^${LAYERDIR}/"
BBFILE_PRIORITY_meta-ollama = "5"

LAYERVERSION_meta-ollama = "1"

LAYERSERIES_COMPAT_meta-ollama = "whinlatter"

LAYERDEPENDS_meta-ollama = " \
    core \
"

LAYER_PATH_meta-ollama = "${LAYERDIR}"

NON_MULTILIB_RECIPES:append = " ollama"

WRL_RECIPES:meta-ollama += " \
    ollama \
    deepseek-r1-7b \
"

PREFERRED_RPROVIDER_deepseek-r1-common ?= "deepseek-r1-1dot5b"
PREFERRED_RPROVIDER_llama3.2-common ?= "llama3.2-1b"
PREFERRED_RPROVIDER_qwen3-common ?= "qwen3-4b"
PREFERRED_RPROVIDER_gemma2-common ?= "gemma2-2b"

BBFILES_DYNAMIC += " \
    tegra:${LAYERDIR}/dynamic-layers/meta-tegra/recipes*/*/*.bb \
    tegra:${LAYERDIR}/dynamic-layers/meta-tegra/recipes*/*/*.bbappend \
"
```
